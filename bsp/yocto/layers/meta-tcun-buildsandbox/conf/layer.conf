## bsp/yocto/layers/meta-tcun-buildsandbox/conf/layer.conf
```bitbake
BBPATH .= ":${LAYERDIR}"

BBFILES += " \
    ${LAYERDIR}/recipes-*/*/*.bb \
    ${LAYERDIR}/recipes-*/*/*.bbappend \
"

BBFILE_COLLECTIONS += "meta-tcun-buildsandbox"
BBFILE_PATTERN_meta-tcun-buildsandbox := "^${LAYERDIR}/"
BBFILE_PRIORITY_meta-tcun-buildsandbox = "6"

LAYERDEPENDS_meta-tcun-buildsandbox = "core"
LAYERSERIES_COMPAT_meta-tcun-buildsandbox = "scarthgap"
```

## bsp/yocto/layers/meta-template-buildsandbox/conf/layer.conf
```bitbake
BBPATH .= ":${LAYERDIR}"

BBFILES += " \
    ${LAYERDIR}/recipes-*/*/*.bb \
    ${LAYERDIR}/recipes-*/*/*.bbappend \
"

BBFILE_COLLECTIONS += "meta-template-buildsandbox"
BBFILE_PATTERN_meta-template-buildsandbox := "^${LAYERDIR}/"
BBFILE_PRIORITY_meta-template-buildsandbox = "6"

LAYERDEPENDS_meta-template-buildsandbox = "core"
LAYERSERIES_COMPAT_meta-template-buildsandbox = "scarthgap"
```
